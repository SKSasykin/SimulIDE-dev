## resources/data/bin/esp/examples/ble-gatt/peripheral/sdkconfig.defaults
```kconfig
CONFIG_BT_ENABLED=y
CONFIG_BT_NIMBLE_ENABLED=y
CONFIG_BT_BLUEDROID_ENABLED=n
CONFIG_BTDM_CTRL_MODE_BLE_ONLY=y
CONFIG_BTDM_CTRL_HCI_MODE_VHCI=y
CONFIG_BT_CTRL_HCI_MODE_VHCI=y
CONFIG_BT_NIMBLE_ROLE_PERIPHERAL=y
CONFIG_BT_NIMBLE_ROLE_BROADCASTER=y
CONFIG_BT_NIMBLE_MAX_CONNECTIONS=1
CONFIG_BT_NIMBLE_HS_FLOW_CTRL=y
CONFIG_ESP_MAIN_TASK_STACK_SIZE=8192
```
